## components/max7219_7221/Kconfig
```kconfig
# -----------------------------------------------------------------------------------
# Copyright 2024, Gilles Zunino
# -----------------------------------------------------------------------------------

menu "MAX7219 / MAX7221 Driver"

    config MAX_7219_7221_ENABLE_DEBUG_LOG
        bool "Enable MAX7219 / MAX7221 debug log"
        default n
        help
            whether to enable the debug log message for the MAX219 / MAX7221 driver.
            Note that this option only controls the MAX7219 / MAX7221 logs.

    config MAX_7219_7221_SANITIZER
        bool "Enable GCC sanitizers"
        default n
        help
            Select this option to enable GCC sanitizers ("-fsanitize=undefined -fno-sanitize=shift-base") on the MAX7219 / max7221 driver.
            Enabling GCC sanitizer can make the code much larger and should not be enabled in production builds.
endmenu
```

## components/maxim-7219-7221/Kconfig
```kconfig
# -----------------------------------------------------------------------------------
# Copyright 2024, Gilles Zunino
# -----------------------------------------------------------------------------------

menu "MAXIM 7219 / 7221 Driver"

    config MAXIM_7219_7221_ENABLE_DEBUG_LOG
        bool "Enable MAXIM 7219 / 7221 debug log"
        default n
        help
            whether to enable the debug log message for the MAXIM 7219 / 7221 driver.
            Note that this option only controls the MAXIM 7219 / 7221 logs.

    config MAXIM_7219_7221_SANITIZER
        bool "Enable GCC sanitizers"
        default n
        help
            Select this option to enable GCC sanitizers ("-fsanitize=undefined -fno-sanitize=shift-base") on the MAXIM 7219 / 7221 driver. Enabling GCC sanitizer can make the code much larger and should not be enabled in production builds.
endmenu
```
